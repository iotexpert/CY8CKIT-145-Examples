# CY8C4045AZI_S413 register map
File version: 0.1
PSoC 4000S
Registers are 32-bit, read-write, no defined reset value unless marked. A register's access mark holds for its fields unless they carry their own. Offsets are from the block's base; lines under a group give offsets from that group; [hi:lo] are bit positions; {n}, {i} and the like mark numbered series; 'fields as' and 'values as' point back to an identical list; <NAME> marks a mode.

## Memory map
0x00000000 PWM

## PWM
Base 0x00000000
0x40060108 COUNTER — Current counter value
0x4006010C CC — Compare / capture value
0x40060110 CC_BUF — Compare / capture buffer value
0x40060114 PERIOD — Period value
0x40060118 PERIOD_BUF — Period buffer value
